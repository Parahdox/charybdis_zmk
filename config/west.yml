## config/west.yml
```yaml
manifest:
  remotes:
    - name: zmkfirmware
      url-base: https://github.com/petejohanson
    - name: badjeff
      url-base: https://github.com/badjeff
  projects:
    - name: zmk
      remote: zmkfirmware
      revision: feat/pointers-with-input-processors
      import: app/west.yml
    - name: zmk-pmw3610-driver
      remote: badjeff
      revision: main
      path: zmk-pmw3610-driver
    - name: zmk-input-behavior-listener
      remote: badjeff
      revision: main
      path: zmk-input-behavior-listener
  self:
    path: config
```
